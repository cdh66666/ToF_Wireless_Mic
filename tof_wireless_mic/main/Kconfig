## tof_wireless_mic/main/Kconfig
```kconfig
menu "Audio Wi-Fi credentials"

config WIFI_SSID
    string "Wi-Fi SSID"
    default "cdh"

config WIFI_PASSWORD
    string "Wi-Fi Password"
    default "cdh888888"

endmenu
```

## tof_wireless_mic_rx/main/Kconfig
```kconfig
menu "Application Configuration"

config WIFI_SSID
    string "Wi-Fi SSID"
    default "cdh"
    help
      SSID of the Wi‑Fi network the device should connect to.

config WIFI_PASSWORD
    string "Wi-Fi Password"
    default "cdh888888"
    help
      Password for the Wi‑Fi network.

endmenu
```
